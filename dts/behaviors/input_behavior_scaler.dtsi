/*
 * Copyright (c) 2020 The ZMK Contributors
 *
 * SPDX-License-Identifier: MIT
 */

/ {
    behaviors {
        /omit-if-no-ref/ ib_scaler: input_behavior_scaler {
            compatible = "zmk,input-behavior-scaler";
            #binding-cells = <2>;
            evt-type = <INPUT_EV_REL>;
            input-code = <INPUT_REL_WHEEL>;
        };
    };
};
