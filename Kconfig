## Kconfig
```kconfig
# Sensor data simulator
#
# Copyright (c) 2019 Nordic Semiconductor
#
# SPDX-License-Identifier: LicenseRef-Nordic-5-Clause
#

DT_COMPAT_ZMK_INPUT_BEHAVIOR_LISTENER := zmk,input-behavior-listener
config ZMK_INPUT_BEHAVIOR_LISTENER
		bool
		default $(dt_compat_enabled,$(DT_COMPAT_ZMK_INPUT_BEHAVIOR_LISTENER))

DT_COMPAT_ZMK_INPUT_BEHAVIOR_SCALER := zmk,input-behavior-scaler
config ZMK_INPUT_BEHAVIOR_SCALER
		bool
		default $(dt_compat_enabled,$(DT_COMPAT_ZMK_INPUT_BEHAVIOR_SCALER))

DT_COMPAT_ZMK_INPUT_BEHAVIOR_TOG_LAYER := zmk,input-behavior-tog-layer
config ZMK_INPUT_BEHAVIOR_TOG_LAYER
		bool
		default $(dt_compat_enabled,$(DT_COMPAT_ZMK_INPUT_BEHAVIOR_TOG_LAYER))

config ZMK_INPUT_BEHAVIOR_LISTENER_USE_HID_IO
		bool "Use HID IO Module to send HID Report"
		default n
```

## dts/bindings/zmk,input-behavior-listener.yaml
```yaml
# Copyright (c) 2020 The ZMK Contributors
# SPDX-License-Identifier: MIT

description: |
  Listener to subscribe to input events and send HID updates after processing

compatible: "zmk,input-behavior-listener"

properties:
  device:
    type: phandle
    required: true
  xy-swap:
    type: boolean
  x-invert:
    type: boolean
  y-invert:
    type: boolean
  scale-multiplier:
    type: int
    default: 1
  scale-divisor:
    type: int
    default: 1

  layers:
    type: array
    default: [-1]
  evt-type:
    type: int
    default: -1
  x-input-code:
    type: int
    default: -1
  y-input-code:
    type: int
    default: -1
  bindings:
    type: phandle-array
```

## dts/bindings/zmk,input-behavior-scaler.yaml
```yaml
# Copyright (c) 2020 The ZMK Contributors
# SPDX-License-Identifier: MIT

description: Input Behavior Scaler

compatible: "zmk,input-behavior-scaler"

include: two_param.yaml

properties:
  evt-type:
    type: int
    default: -1
  input-code:
    type: int
    default: -1
```

## dts/bindings/zmk,input-behavior-tog-layer.yaml
```yaml
# Copyright (c) 2020 The ZMK Contributors
# SPDX-License-Identifier: MIT

description: Input Behavior To Toggole Layer

compatible: "zmk,input-behavior-tog-layer"

include: one_param.yaml

properties:
  time-to-live-ms:
    type: int
    default: 500
```
